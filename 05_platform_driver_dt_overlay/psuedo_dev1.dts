/dts-v1/;
/plugin/;

/{
	fragment@0 {
		target = <&psuedo_device_1>;
		__overlay__{
			status = "disabled";
		};
	};
	fragment@1 {
		target = <&psuedo_device_2>;
		__overlay__{
			status = "disabled";
		};
	};
	fragment@2 {
		target = <&psuedo_device_3>;
		__overlay__{
			// status = "disabled";
			org,size = <2048>;
			org,device_serial = "PSUDO_CHAR_069";
			status = "okay";
		};
	};
};